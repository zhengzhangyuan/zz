#include "LCD12864_VIEW.H"

extern unsigned char gra12864[64][16];//显存

/*------------------------------------------------
                 设置到绘图模式
------------------------------------------------*/
void graphicmode12864()
{
	   Cmd_12864(0x36);       //选择8bit数据流 图形模式
}
/*------------------------------------------------
                   液晶屏初始化
------------------------------------------------*/
void init12864()
{
	Init_12864();
}
/*------------------------------------------------
                   显示字符串
x:横坐标值，范围0~8
y:纵坐标值，范围1~4
------------------------------------------------*/
void string12864(unsigned char x,unsigned char y, char  *s)
{
	  Cmd_12864(0X30); 
 switch(y)
     {
	  case 0: Cmd_12864(0x80+x);break;
	  case 1: Cmd_12864(0x90+x);break;
	  case 2: Cmd_12864(0x88+x);break;
	  case 3: Cmd_12864(0x98+x);break;
	  case 4: Cmd_12864(0XA0+x);break;
	  case 5: Cmd_12864(0XB0+x);break;
	  case 6: Cmd_12864(0XA8+x);break;
	  case 7: Cmd_12864(0XB8+x);break;
      default:break;
	 }
 while(*s>0)
   { 
      Data_12864(*s);
      s++;
   }
}
/*------------------------------------------------
                      清屏
------------------------------------------------*/
void cls12864()
{
	 unsigned char i; 
//      Cmd_12864(0X30);
//   Cmd_12864(0x01);
   
     Cmd_12864(0x30);     
     Cmd_12864(0x80);      
     for(i=0;i<64;i++)
     Data_12864(0x20);
}
/*------------------------------------------------
                   显示图片
------------------------------------------------*/
void graphic12864()
{
	 int i,j;

//显示上半屏内容设置
   for(i=0;i<32;i++)            
    { 
      Cmd_12864(0x80 + i); //SET  垂直地址 VERTICAL ADD
      Cmd_12864(0x80);     //SET  水平地址 HORIZONTAL ADD
      for(j=0;j<16;j++)
       {
         Data_12864(gra12864[i][j]);
       }
    }
//显示下半屏内容设置
   for(i=0;i<32;i++)            
    {
       Cmd_12864(0x80 + i); //SET 垂直地址 VERTICAL ADD
       Cmd_12864(0x88);     //SET 水平地址 HORIZONTAL ADD
      for(j=0;j<16;j++)
       {
         Data_12864(gra12864[i+32][j]);
       }
    }
}
/************************************************
					刷新屏幕
************************************************/
void refresh_12864()
{
	  Cmd_12864(0x34);//高级模式
  graphicmode12864();//绘图模式
  graphic12864();
  Cmd_12864(0x30);//基础模式 
}

