#include <stdio.h>
#include <string.h>
#include "Device_Conf.h"
#include "home.h"


//extern DS1302_Typedef   DS1302_Data;
//extern char EC11_Data ;
extern char HKEY;
extern unsigned int  SystemClock;
unsigned int Fanbai_Addr [8]={0};
 char  *Error_subtitle [] =
{
  "换页失败",
  "未找到当前页码" ,
  "Page_Error",
  "Can't find page" ,
};
 char  *home_subtitle [] =
{
  "游戏 GAME",
  "设置 SET" ,
  "亮度 LIGHT",
  "关于 ABOUT" ,
};
 char  *game_subtitle [8] =
{
  "2048游戏",
  "贪吃蛇游戏",
  "打砖块游戏",
  "俄罗斯方块",
  "    返回      ",
  "            ",
  "            ",
  "            ",
} ;
 char  *set_subtitle [] = 
{
 "    设置 SET",
 "亮度设置",
 "时间设置",
 "系统时钟设置",
 "串口波特率设置",
 "串口通讯测试",
  "串口发送内容设置",
  "输入设备设置",
  "副屏幕设置",
  "繁体中文",
  "演示模式",
  "返回",
};
 char *light_subtitle [] = 
{
 "  调整方式",
 "手动调整",
 "自动调整",
  "返回        ",
} ;

 char *light_set [] =
{
  "",
 "",
 "",
  "返回",
};

 char *time_set_subtitle [] =
{
 "  时间 TIME",
 "",
 "",
 "",
 "",
 "",
 "",
 "",
  "返回",
   "",
 "",
 "",
};

 char *inveter_subtitle []=
{
 "  逆变 INVERTER",
 "直流电机调速",
 "双半桥斩波器",
 "SPWM逆变器",
 "返回",
 "",
 "",
 "",
};

 char *bldc_subtitle[] = 
{
  "直流电机调速",
 "",
 "",
 "",
 "",
 "",
 "电机测试",
 "返回",
};

const unsigned char Home_Pic[64][16]=
{
 0x00,0x00,0x00,0x00,0x00,0x00,0x00,0x00,0x00,0x00,0x00,0x00,0x00,0x00,0x00,0x00,
0x00,0x00,0x00,0x00,0x00,0x00,0x00,0x00,0x00,0x00,0x00,0x00,0x00,0x00,0x00,0x00,
0x00,0x00,0x00,0x00,0x00,0x00,0x00,0x00,0x00,0x00,0x00,0x00,0x00,0x00,0x00,0x00,
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0x00,0x00,0x00,0x00,0x00,0x00,0x00,0x00,0x00,0x00,0x00,0x00,0x00,0x00,0x00,0x00,
};

const unsigned char YIYIUNION_Pic[64][16]=
{
 0xFF,0xFF,0xFF,0xFF,0xFF,0xFF,0xFF,0xFF,0xFF,0xFF,0xFF,0xFF,0xFF,0xFF,0xFF,0xFF,
0xFF,0xFF,0xFF,0xFF,0xFF,0xFF,0xFF,0xFF,0xFF,0xFF,0xFF,0xFF,0xFF,0xFF,0xFF,0xFF,
0xFF,0xFF,0xFF,0xFF,0xFF,0xFF,0xFF,0xFF,0xFF,0xFF,0xFF,0xFF,0xFF,0xFF,0xFF,0xFF,
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0xFF,0xFF,0xFF,0xFF,0xFF,0xFF,0xFF,0xFF,0xFF,0xFF,0xFF,0xFF,0xFF,0xFF,0xFF,0xFF, 
};

const unsigned char pic0[64][16]=
{
  0x00,0x00,0x00,0x00,0x00,0x00,0x00,0x01,0xFF,0xFF,0xFC,0x00,0x00,0x00,0x00,0x00,
0x00,0x00,0x00,0x00,0x00,0x00,0x00,0x03,0xFF,0xFF,0xF8,0x00,0x00,0x00,0x00,0x00,
0x00,0x00,0x00,0x00,0x00,0x00,0x00,0x03,0xFF,0xFF,0xF8,0x00,0x00,0x00,0x00,0x00,
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0x00,0x00,0x00,0x00,0x00,0x00,0x00,0x00,0x00,0x00,0x00,0x00,0x00,0x00,0x00,0x00,
};
const unsigned char pic1[64][16]=
{
  0x00,0x00,0x00,0x00,0x00,0x00,0x00,0x00,0x00,0x00,0x00,0x00,0x00,0x00,0x00,0x00,
0x00,0x00,0x00,0x00,0x00,0x00,0x00,0x00,0x00,0x00,0x00,0x00,0x00,0x00,0x00,0x00,
0x00,0x00,0x00,0x00,0x00,0x00,0x00,0x00,0x00,0x00,0x00,0x00,0x00,0x00,0x00,0x00,
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0x00,0x00,0x00,0x00,0x00,0x00,0x00,0x00,0x00,0x00,0x00,0x00,0x00,0x00,0x00,0x00,
//0x00,0x00,0x00,0x00,0x00,0x00,0x00,0x00,0x00,0x00,0x00,0x00,0x00,0x00,0x00,0x00,
};

const unsigned char NCHU_Subitile[64][16]=
{
0x00,0x00,0x00,0x00,0x00,0x00,0x00,0x00,0x00,0x00,0x00,0x00,0x00,0x00,0x00,0x00,
0x00,0x00,0x00,0x00,0x00,0x00,0x00,0x00,0x00,0x00,0x00,0x00,0x00,0x00,0x00,0x00,
0x00,0x00,0x00,0x00,0x00,0x00,0x00,0x00,0x00,0x00,0x00,0x00,0x00,0x00,0x00,0x00,
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0x00,0x00,0x00,0x00,0x00,0x00,0x00,0x00,0x00,0x00,0x00,0x00,0x00,0x00,0x00,0x00,
};

 const unsigned char logio [16]={"仙  童  科  技"} ;
 const unsigned char jindu [17]={"/______________/"};

 const unsigned char Function_Table [PAGE_LIMIT][LINE_LIMIT]	=  //界面跳转及功能设置
{
 Game_Page,Inveter_Page,Set_Page,About_Page,0X00,0X00,0X00,0X00,0X00,0X00,0X00,0X00,//主界面
 0X00,0X00,0X00,0X00,Home_Page,0X00,0X00,0X00,0X00,0X00,0X00,0X00,//游戏界面
 0X00,Bldc_Page,0X00,0X00,Home_Page,0X00,0X00,0X00,0X00,0X00,0X00,0X00,//逆变器主页
 0X00,Light_Page,Time_Set_Page,0X00,0X00,0X00,0X00,0X00,0X00,0X00,0X00,Home_Page,//设置界面
 0X00,0X00,0X00,0X00,0X00,0X00,0X00,0X00,0X00,0X00,0X00,0X00,//关于界面
 0X00,Light_Set_Page,0X00,Set_Page,0X00,0X00,0X00,0X00,0X00,0X00,0X00,0X00,//亮度设置界面
 0X00,0X00,0XFF,Light_Page,0X00,0X00,0X00,0X00,0X00,0X00,0X00,0X00,//手动亮度调节界面
 0X00,0XFF,0XFF,0XFF,0XFF,0XFF,0XFF,0XFF,Set_Page,0X00,0X00,0X00,//时间设置界面
 0X00,0XFF,0XFF,0XFF,0XFF,0XFF,0XFF,Inveter_Page,0X00,0X00,0X00,0X00,//直流电机调速见面
};
//注意： 高四位代表行下限，低四位代表行上限
const unsigned char Line_Limit [PAGE_LIMIT] = 	//页最大行设置
{
 0X03,//主界面
 0X04,//游戏界面
 0X14,//逆变器主页
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 0X17,//直流电机调速界面
};

Page_InformationTypedef  Page_Info = Page_InformationTypedef_Init;//页面结构体初始化
unsigned char Function_Infomation = 0;	   //功能调整函数信息载
 unsigned char  Function_Flag = 0;//功能调整函数进入标志 
/*********************************
		主界面
**********************************/
void Home_12864 ()
{
 unsigned char Page_Temp,Line_Temp_A,Line_Temp_B,special_function=0;
 ///////////////////换页操作///////////////////////////////
  if(HKEY==6)
  {
     HKEY = 0;
   if(Function_Table[Page_Info.Now_Page&0X1F][Page_Info.Now_Line]==0)  return;
   else
   {
    if(Function_Table[Page_Info.Now_Page&0X1F][Page_Info.Now_Line]==0XFF)
		if(Page_Info.Special_Function==0)
		Page_Info.Special_Function = 1;
		else
		Page_Info.Special_Function = 0;
	else	
   	Page_Info.Now_Page = Function_Table[Page_Info.Now_Page&0X1F][Page_Info.Now_Line];
   }
  }
 ///////////////////换页执行///////////////////////////////
  if(Page_Info.Now_Page != Page_Info.Last_Page)
  {
	 Page_Info.Last_Page = Page_Info.Now_Page;
     Page_Info.Now_Line  = Line_Limit[Page_Info.Now_Page&0X1F]>>4;
	 Page_Info.Last_Line = Line_Limit[Page_Info.Now_Page&0X1F]>>4;
	 if(Page_Info.Now_Page>0X7F)
	 {
	   Page_Temp = Page_Info.Last_Page&0X1F;
	   switch(Page_Temp)
	   {
	   	 case 0:Fgraphic12864(FAST,POSITIVE,Draw,Home_Pic);Page_gra_Init(Page_Info.Now_Line);break;
		  default :cls12864();clsgraphic();string12864_all(70,0,0,Error_subtitle) ;while(1); break;
	   }
	 }
	 else
	 {
	   switch(Page_Info.Now_Page)
	   {
		 case Game_Page: Page_Init(Page_Info.Now_Line);string12864_all(70,1,0,game_subtitle) ; break;	//显示主界面内容
		 case Set_Page : Page_Init(Page_Info.Now_Line);string12864_all(0,0,0,set_subtitle);Function_Flag = 0;break;
		 case Light_Page:Page_Init(Page_Info.Now_Line);string12864_all(70,1,0,light_subtitle);Function_Flag = 0;break;
		 case Inveter_Page:Page_Init(Page_Info.Now_Line);string12864_all(0,0,0,inveter_subtitle);Function_Flag = 0;break;
		 case Light_Set_Page: cls12864();clsgraphic();point_line(ENABLE,Page_Info.Now_Line);string12864_all(70,1,0,light_set);Function_Flag = 1;break;
		 case Time_Set_Page : cls12864();clsgraphic();point_line(ENABLE,Page_Info.Now_Line);string12864_all(70,1,0,time_set_subtitle); Function_Flag = 2;Function_Infomation = Page_Info.Now_Line<<4;break;
		 case Bldc_Page:      cls12864();clsgraphic();point_line(ENABLE,Page_Info.Now_Line);string12864_all(0,1,0,bldc_subtitle);Function_Flag = 3;  Function_Infomation = Page_Info.Now_Line<<4;break;
		 default :cls12864();clsgraphic();string12864_all(70,0,0,Error_subtitle) ; while(1); break;
	   }
	 }
  }
/////////////////////特殊功能使能////////////////////////
if(Page_Info.Special_Function)
{
   if((SystemClock/20)%2)  point_line (ENABLE,Page_Info.Now_Line%4);
   else                    point_line (DISABLE,Page_Info.Now_Line%4);
 if(HKEY)
 {
  switch(HKEY)
  {
   case 1: special_function = 1; break;
   case 2: special_function = 2; break; 
  }
  HKEY = 0;
 }
 Function_Infomation = (Page_Info.Now_Line<<4)+special_function;
}
/////////////////////换行操作//////////////////////////// 	  
  if(HKEY)
  {
   switch(HKEY)
   {
	case 1: if(Page_Info.Last_Line>(Line_Limit[Page_Info.Now_Page&0X1F])>>4)Page_Info.Now_Line--; break;
	case 2: if(Page_Info.Last_Line<((Line_Limit[Page_Info.Now_Page&0X1F])&0X0F))Page_Info.Now_Line++; break;
   }
   HKEY = 0;
  }
////////////换屏操作////////////////////////////   
  if(Page_Info.Last_Line != Page_Info.Now_Line)
  {
   Line_Temp_A = Page_Info.Last_Line/4;
   Line_Temp_B = Page_Info.Now_Line/4;
   if((Line_Temp_A!=Line_Temp_B)&&(Page_Info.Now_Page<=0X7F))						  
   {
	   if((Line_Limit[Page_Info.Now_Page&0X1F]&0X0F)/4<Line_Temp_B)	 Line_Temp_B = (Line_Limit[Page_Info.Now_Page&0X1F]&0X0F)/4;
	  	   switch(Page_Info.Now_Page)
	   {
		 case Game_Page: string12864_all(70,1,Line_Temp_B,game_subtitle) ; break;	
		 case Set_Page : cls12864();string12864_all(0,0,Line_Temp_B,set_subtitle);break;
		 case Light_Page:cls12864();string12864_all(70,1,Line_Temp_B,light_subtitle);break;
		 case Time_Set_Page:cls12864();string12864_all(70,1,Line_Temp_B,time_set_subtitle);break; 
		 case Inveter_Page: cls12864();string12864_all(0,0,Line_Temp_B,inveter_subtitle);break;
		 case Bldc_Page:   cls12864();string12864_all(0,1,Line_Temp_B,bldc_subtitle);break;
		  default :cls12864();clsgraphic();string12864_all(70,0,0,Error_subtitle) ; while(1); break;
	   }

   }
/////////////////////换行执行//////////////////////////// 

   Function_Infomation = Page_Info.Now_Line<<4;//向特殊功能函数提供行信息

   if(Page_Info.Now_Page<=0X1F)
   {
	 fanbai(Page_Info.Now_Line%4);
   }
   else if((Page_Info.Now_Page&0XE0)==0X20)
   {
    point_line (ENABLE,Page_Info.Now_Line%4);
   }
   else
   {
	fanbai_gra(OLD,Page_Info.Now_Line%4);
   }
   Page_Info.Last_Line = Page_Info.Now_Line;
  }
}
/************************************
	新页初始化
************************************/
void Page_Init(unsigned char New_Page_Line)
{
      clsgraphic();
 	 cls12864();
	 fanbai(New_Page_Line);
}
void Page_gra_Init(unsigned char New_Page_Line)
{
//      clsgraphic();
 	 cls12864();
	 fanbai_gra(NEW,New_Page_Line);
}
///**************************
//	 副屏幕显示函数
//**************************/
//void Home_1602  ()   //副屏幕显示函数
//{
// unsigned char str_1602[17] = {0};
// static unsigned char flag_1602 = 0;
// static unsigned int  Temp_Time = 0;
////	  if((flag_1602>=0&&flag_1602<=15)||(flag_1602>=48&&flag_1602<=63)) cmd1602(leftm);

//	  if(((SystemClock/LCD_1602_MoceSpeed)%2)!=Temp_Time) 
//	  {
////	  if((flag_1602>=0&&flag_1602<=15)) cmd1602(leftm);
//      sprintf(str_1602,"%2d:%2d:%2d Thurday",(int)DS1302_Data.hour,(int)DS1302_Data.minute,(int)DS1302_Data.second);
//	    string1602(16,1,str_1602);
//      sprintf(str_1602,"Today 20%2d.%2d.%2d",(int)DS1302_Data.year,(int)DS1302_Data.month,(int)DS1302_Data.date);
//	    string1602(16,0,str_1602);
//	  if((flag_1602>=0&&flag_1602<=15)||(flag_1602>=48&&flag_1602<=71)) cmd1602(leftm);
//       flag_1602++;
//	  if(flag_1602>103) flag_1602 = 0;
//	  }
//	  Temp_Time = (SystemClock/LCD_1602_MoceSpeed)%2;
//}
/**************************
自检界面
*************************/
void post ()
{
const unsigned char *ljk=0;
//  cls1602();//清屏
//  string1602(16,1,"849567151@qq.com");
//  string1602(16,0,"Fairchild   1947");

 Cmd_12864(0x34);//高级模式
 ////////////////////////////
 cls12864();
 clsgraphic();
//   sumgra12864(0,0,BIG,"18:51:23");
//  sumgra12864(0,2,BIG,"FAIRHILD");
//
// delayms(1500);
// clsgraphic();
// sumgra12864(0,0,MIDDLE,"18:51:23");
// sumgra12864(0,1,MIDDLE,"FAIRCHILD");
// delayms(1500);
// clsgraphic();
//   sumgra12864(0,0,SMALL,"18:51:23");
//  sumgra12864(0,1,SMALL,"FAIRCHILD");
// delayms(1500);
// clsgraphic();

Fgraphic12864(NORMAL,POSITIVE,Baiye_X,pic0);
Fgraphic12864(NORMAL,POSITIVE,Baiye_X_Clear,pic0);
Fgraphic12864(FAST,OPPOSITE,Round_S,YIYIUNION_Pic);
Fgraphic12864(FAST,OPPOSITE,Round_S_Clear,YIYIUNION_Pic);
Fgraphic12864(FAST,OPPOSITE,Suijixian_Y,pic0);
Fgraphic12864(FAST,OPPOSITE,Suijixian_Y_Clear,pic0);
Fgraphic12864(FAST,POSITIVE,Into_Y,NCHU_Subitile);
Fgraphic12864(FAST,POSITIVE,Fanzhuan,NCHU_Subitile);
delayms(250);
Fgraphic12864(FAST,POSITIVE,Fanzhuan,NCHU_Subitile);
delayms(250);
Fgraphic12864(FAST,POSITIVE,Fanzhuan,NCHU_Subitile);
delayms(250);
Fgraphic12864(FAST,POSITIVE,Fanzhuan,NCHU_Subitile);
delayms(250);
Fgraphic12864(FAST,POSITIVE,Out_Y,NCHU_Subitile);
//delayms(1500);
  clsgraphic();
//	ygra12864(UP,FAST,63,pic0);
//	delayms(1500);
//	gra12864(POSITIVE,NCHU_Subitile);
//	delayms(250);
//	gra12864(OPPOSITE,NCHU_Subitile);
//	delayms(250);
//	gra12864(POSITIVE,NCHU_Subitile);
//	delayms(250);
//	gra12864(OPPOSITE,NCHU_Subitile);
//	delayms(250);
	clsgraphic();
///////////////////////////////////

Fgraphic12864(FAST,POSITIVE,Draw,pic1);


 Cmd_12864(0x30);//基础模式

 Cmd_12864(0x88);
 ljk=logio;
 while(*ljk)
 {
   Data_12864(*ljk);
   ljk++;
   delayms(100);
 }


  Cmd_12864(0x98);
   ljk=jindu;

 while(*ljk)
 {

   Data_12864(*ljk);
   ljk++;
   delayms(100);
 }
  cls12864();
}

